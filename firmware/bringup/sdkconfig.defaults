## firmware/bringup/sdkconfig.defaults
```kconfig
# ESP32-C3FH4：4MB flash
CONFIG_ESPTOOLPY_FLASHSIZE_4MB=y
CONFIG_ESPTOOLPY_FLASHSIZE="4MB"
CONFIG_PARTITION_TABLE_SINGLE_APP_LARGE=y

# bring-up 工程不启用蓝牙：本票只观察灯带与供电。
CONFIG_BT_ENABLED=n

# 日志
CONFIG_LOG_DEFAULT_LEVEL_INFO=y
```
